## Kconfig
```kconfig
#
# RVISS 顶层 Kconfig
#
# 组织方式是 Linux/NEMU 风格：顶层只放全局选项，子系统用自己的 Kconfig，
# 由这里 source 进来。加新子系统 = 建一个 Kconfig + 这里加一行 source。
#

mainmenu "RVISS Configuration"

config TARGET_RISCV64
	bool
	default y

menu "Build setup"

choice
	prompt "优化等级"
	default CC_O2
	help
	  -O2 适合日常跑；用 gdb 单步时建议 -O0（见 debug_defconfig）。

config CC_O0
	bool "-O0（不优化，便于调试）"
config CC_O1
	bool "-O1"
config CC_O2
	bool "-O2"
config CC_O3
	bool "-O3"

endchoice

config CC_OPT
	string
	default "-O0" if CC_O0
	default "-O1" if CC_O1
	default "-O2" if CC_O2
	default "-O3" if CC_O3

config CC_DEBUG
	bool "生成调试信息（-ggdb3）"
	default y
	help
	  关掉则二进制里没有符号，gdb 无法按源码单步。

config CC_STRICT
	bool "把编译警告当错误（-Werror）"
	default y

config CC_LTO
	bool "链接时优化（-flto）"
	default n
	help
	  LTO 会把函数合并，gdb 断点可能失效，调试期建议关闭。

config CC_NATIVE
	bool "针对本机 CPU 优化（-march=native）"
	default n

endmenu

menu "Engine"

choice
	prompt "执行引擎"
	default ENGINE_INTERPRETER
	help
	  目前只有解释器一种。引擎与 target 通过 include/rtl/rtl.h 解耦，
	  将来加 JIT 时只需要新增一个 engine 目录。

config ENGINE_INTERPRETER
	bool "解释器（interpreter）"

endchoice

config ENGINE
	string
	default "interpreter" if ENGINE_INTERPRETER

endmenu

menu "Debug and trace"

config DEBUG
	bool "启用日志系统"
	default y
	help
	  关掉后所有 Log* 变成空操作，用于跑性能或减小二进制。

config TRACE_INST
	bool "指令 trace（pc + 助记符）"
	depends on DEBUG
	default n

config TRACE_INST_DASM
	bool "指令 trace（含原始编码与操作数）"
	depends on DEBUG
	default n
	help
	  等价于 NEMU 的 TRACE_INST_DASM。运行时再配合 -t/--trace 或
	  --log-level 4 打开。

config TRACE_MEM
	bool "访存 trace"
	depends on DEBUG
	default n

config TRACE_MMU
	bool "地址翻译 / TLB trace"
	depends on DEBUG
	default n

config SHARE
	bool "编译为 difftest 参考共享库（librviss_ref.so）"
	default n
	help
	  产物供香山 / XS-GEM5 等 DUT 通过 dlopen 加载做逐指令对拍，
	  对外 ABI 见 include/rviss.h。

endmenu

source "src/machine/Kconfig"
source "src/device/Kconfig"
source "src/target/riscv64/Kconfig"

menu "RV64 platform profiles"

config RV64_LINUX
	bool "固定 Linux/OpenSBI RV64GC 单 hart 平台"
	default n
	select HAS_CLINT
	select HAS_UART16550
	select HAS_PLIC
	select HAS_TEST_FINISHER
	select RV_ZICSR
	select RV_M
	select RV_A
	select RV_C
	select RV_PMP
	select RV_SV39
	select RV_F
	select RV_D
	help
	  选择固定的 Linux 6.11.4 + OpenSBI generic RV64GC 输入配置。
	  对应 Linux 的 ARCH_RV64I、MMU、FPU、RISCV_ISA_C 和 SMP=n，
	  以及 OpenSBI 的 UART8250、CLINT MTIMER/MSWI、PLIC、SYSCON reset。
	  本项目只实现 RV64 单 hart；此选项不引入 RV32、Sv48、V、H 或 Sstc。
	  固定 DTB 使用 256 MiB RAM，运行时不应再用 --memory 改变其地址图。

endmenu
```

## configs/c_defconfig
```kconfig
# RVISS C 验证配置：默认设备齐全，-O2，带调试信息（发布/日常跑用）
# 用法: make c_defconfig

CONFIG_TARGET_RISCV64=y

CONFIG_CC_O2=y
CONFIG_CC_DEBUG=y
CONFIG_CC_STRICT=y
CONFIG_CC_LTO=n
CONFIG_CC_NATIVE=n

CONFIG_ENGINE_INTERPRETER=y

CONFIG_DEBUG=y
CONFIG_TRACE_INST=n
CONFIG_TRACE_INST_DASM=n
CONFIG_TRACE_MEM=n
CONFIG_TRACE_MMU=n
CONFIG_SHARE=n

CONFIG_MBASE=0x80000000
CONFIG_MSIZE=0x8000000
CONFIG_PC_RESET_OFFSET=0x0

CONFIG_HAS_CLINT=y
CONFIG_HAS_UART16550=y
CONFIG_HAS_PLIC=y

CONFIG_RV_ZICSR=y

CONFIG_RV_C=y
```

## configs/gc_defconfig
```kconfig
# RVISS RV64GC + PMP + Sv39 验证配置
# 用法: make pmp_defconfig

CONFIG_TARGET_RISCV64=y

CONFIG_CC_O2=y
CONFIG_CC_DEBUG=y
CONFIG_CC_STRICT=y
CONFIG_CC_LTO=n
CONFIG_CC_NATIVE=n

CONFIG_ENGINE_INTERPRETER=y

CONFIG_DEBUG=y
CONFIG_TRACE_INST=n
CONFIG_TRACE_INST_DASM=n
CONFIG_TRACE_MEM=n
CONFIG_TRACE_MMU=n
CONFIG_SHARE=n

CONFIG_MBASE=0x80000000
CONFIG_MSIZE=0x8000000
CONFIG_PC_RESET_OFFSET=0x0

CONFIG_HAS_CLINT=y
CONFIG_HAS_UART16550=y
CONFIG_HAS_PLIC=y

CONFIG_RV_ZICSR=y

CONFIG_RV_M=y
CONFIG_RV_A=y
CONFIG_RV_C=y

CONFIG_RV_PMP=y

CONFIG_RV_SV39=y

CONFIG_RV_F=y
CONFIG_RV_D=y
```

## src/device/Kconfig
```kconfig
#
# 设备开关
#
# 关掉的设备：代码不编译进二进制（见顶层 Makefile 的 SRCS-$(CONFIG_...)），
# 对它的 MMIO 访问会落到"未映射地址"分支。
#

menu "Devices"

config HAS_CLINT
	bool "CLINT（mtime/mtimecmp/msip）"
	default y
	help
	  对应 OpenSBI generic 的 CONFIG_FDT_TIMER_MTIMER 和 CONFIG_FDT_IPI_MSWI。
	  mtime 由独立的平台逻辑 tick 驱动（每 128 ticks +1），不读宿主时钟。

config HAS_UART16550
	bool "UART 16550（串口）"
	default y
	help
	  对应 OpenSBI 的 CONFIG_FDT_SERIAL_UART8250/CONFIG_SERIAL_UART8250，
	  以及 Linux 的 CONFIG_SERIAL_8250、CONFIG_SERIAL_OF_PLATFORM。
	  DLAB/FIFO/IRQ/loopback，板级接 stdin/stdout。

config HAS_PLIC
	bool "PLIC（平台级中断控制器）"
	default y
	help
	  对应 OpenSBI 的 CONFIG_FDT_IRQCHIP_PLIC/CONFIG_IRQCHIP_PLIC。
	  两个 M/S 上下文，sources1..31，priority/claim/complete。

config HAS_TEST_FINISHER
	bool "SiFive test finisher（关机）"
	default y
	help
	  对应 OpenSBI 的 CONFIG_FDT_REGMAP_SYSCON 和 CONFIG_FDT_RESET_SYSCON；
	  固定 virt syscon 写5555成功、3333失败。

endmenu
```

## src/machine/Kconfig
```kconfig
#
# 机器/板级参数
#
# 这里是"编译期板子默认值"；运行期仍可用命令行覆盖
# （--memory 覆盖 RAM 大小），一次编译多种跑法。
#

menu "Machine"

config MBASE
	hex "RAM 基址"
	default 0x80000000

config MSIZE
	hex "RAM 大小（字节）"
	default 0x8000000
	help
	  默认 128 MiB。

config PC_RESET_OFFSET
	hex "复位向量相对 RAM 基址的偏移"
	default 0x0
	help
	  裸机程序直接放在 RAM 起始时填 0（默认）。
	  香山那种"bbl 在 RAM 起始、复位向量在 +1MiB"的板子填 0x100000。

endmenu
```

## src/target/riscv64/Kconfig
```kconfig
#
# RISC-V 扩展开关
#
# 与 Linux arch/riscv 的扩展清单对齐：先做"能跑 Linux"的必需集，
# 再做内核用到的可选加速/特性。落地顺序见 docs/implementation_plan.md。
#

menu "RISC-V extensions"

comment "基础（已实现）"

config RV_ZICSR
	bool "Zicsr（CSR 读写指令）"
	default y
	help
	  关掉后 csrrw/csrrs/csrrc 等指令变成非法指令。

config RV_ZIFENCEI
	bool "Zifencei（指令流同步）"
	default y
	help
	  提供 fence.i 指令。当前 RVISS 是有序功能模型，没有译码缓存，
	  因此 fence.i 的执行效果是合法退休但不需要刷新宿主缓存；关闭后
	  该编码变成非法指令。该开关与 Linux 的 Zifencei ISA 身份保持一致。

config RV_ZICNTR
	bool "Zicntr（基础计数器与计时器）"
	depends on RV_ZICSR
	default y
	help
	  提供只读 cycle/time/instret CSR，关闭后访问它们产生非法指令。
	  机器级 mcycle/minstret 和计数器控制 CSR 仍属于特权架构；关闭
	  Zicntr 不关闭机器计数或 CLINT 时间，counteren 的 CY/TM/IR 读零。
	  引擎预算/累计退休与客户机计数始终分开；此选项不包含 Zihpm。

comment "Linux 必需扩展（能力以验证任务为准）"

config RV_M
	bool "M：乘除法（mul/div/rem）"
	help
	  RV64 M 2.0 的 13 条指令；关闭时相应编码为非法指令。
config RV_A
	bool "A：原子指令（lr/sc/amo）"
	help
	  RV64 A 2.1；单 hart RAM LR/SC 和 W/D AMO，设备原子访问产生 fault。
config RV_F
	bool "F：单精度浮点"
	depends on RV_ZICSR
	help
	  F 2.2，FLEN32、五种舍入模式、FCSR 与 FS 状态。
config RV_D
	bool "D：双精度浮点"
	depends on RV_F
	help
	  D 2.2，FLEN64、单精度 NaN boxing 与 S/D 转换。
config RV_C
	bool "C：压缩指令（RVC）"
	help
	  RV64 C 2.0 整数压缩指令；misa.C 控制 IALIGN 与动态启用。
	  编译 D 时包含 C.FLD/FSD/FLDSP/FSDSP。

comment "地址翻译（Bare 始终可用；分页能力编译期选择）"

config RV_SV39
	bool "Sv39 分页"
	help
	  编译 Sv39 页表遍历器；运行时 satp.MODE=0 仍选择 Bare，MODE=8 选择 Sv39。
	  关闭此选项时只提供 Bare 地址转换；启用时仍可按运行时 satp 在两者间选择。
	  ASIDLEN=0，支持 4K/2M/1G、PMP 页表保护与硬件 A/D 更新。

# Sv48 没有实现，因此暂不提供可选的 Kconfig 符号；实现后再加入。

config RV_PMP
	bool "PMP：物理内存保护"
	help
	  16 entries，粒度 4 bytes，OFF/TOR/NA4/NAPOT；关闭时 0 entries。

choice
	prompt "RV64 数据非对齐访问"
	default RV_MISALIGNED_TRAP
	help
	  选择 CPU 对普通数据 load/store 的非自然对齐行为。LR/SC/AMO
	  始终要求自然对齐；MMIO 不通过拆分访问模拟。

config RV_MISALIGNED_TRAP
	bool "非对齐访问产生异常（Linux 可由内核仿真）"
	help
	  模拟硬件对非对齐标量访问抛出 load/store-misaligned。此模式对应
	  固定 Linux 的 RISCV_PROBE_UNALIGNED_ACCESS：Linux 可以在陷阱中
	  仿真访问，并据此报告硬件速度。

config RV_MISALIGNED_NATIVE
	bool "RAM 非对齐访问由 RVISS 拆分完成"
	help
	  普通 RAM load/store 在访问宽度的自然对齐边界拆成两段。
	  两段都完成翻译、PMP 和 RAM 检查后才读写，跨页不会跳过第二页。
	  取指始终不支持非对齐。MMIO 不拆成多次访问。

endchoice

comment "阶段二：可选特性（未实现）"

config RV_B
	bool "B：位操作（Zba/Zbb/Zbs）"
config RV_V
	bool "V：向量（RVV 1.0）"
config RVH
	bool "H：虚拟化（两阶段翻译）"
config RV_SSTC
	bool "Sstc：S 模式定时器"

endmenu
```
